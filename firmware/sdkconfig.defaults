## firmware/sdkconfig.defaults
```kconfig
# sdkconfig.defaults for uzigbee (ESP32-C6)
# ESP-IDF v5.3.2, MicroPython v1.27.0

# Zigbee (effective once esp-zigbee-lib is wired)
CONFIG_ZB_ENABLED=y
CONFIG_ZB_ZCZR=y
# For end-device-only build, switch to:
# CONFIG_ZB_ZED=y

# 802.15.4 radio
CONFIG_IEEE802154_ENABLED=y

# Memory/size optimizations
CONFIG_FREERTOS_PLACE_FUNCTIONS_INTO_FLASH=y
CONFIG_COMPILER_OPTIMIZATION_SIZE=y
CONFIG_LOG_DEFAULT_LEVEL_WARN=y

# Partition table
CONFIG_PARTITION_TABLE_CUSTOM=y
CONFIG_PARTITION_TABLE_CUSTOM_FILENAME="../../../../firmware/partitions.csv"

# Stack sizes
CONFIG_ESP_MAIN_TASK_STACK_SIZE=8192

# Zigbee options
# Green Power must be enabled for current ZCZR linkage.
CONFIG_ZB_GP_ENABLED=y
```
